## main/Kconfig.projbuild
```kconfig
menu "RadioFloppy"

    config RADIOFLOPPY_WIFI_SSID
        string "Default WiFi SSID"
        default ""
        help
            Network to join until one is set in WiFi setup mode (settings on
            the external flash take precedence). Empty and nothing saved:
            RadioFloppy starts in WiFi setup mode.
            Stored in sdkconfig, which is not committed to git.

    config RADIOFLOPPY_WIFI_PASSWORD
        string "Default WiFi password"
        default ""

    config RADIOFLOPPY_HOSTNAME
        string "Default hostname (network name)"
        default "RadioFloppy"

    config RADIOFLOPPY_API_TOKEN
        string "Optional API token for upload / delete / activate"
        default ""
        help
            Empty (default): the API is open to everyone on the network.
            Set a token only on a shared network; clients then send it as
            "Authorization: Bearer <token>" and the web page asks for it.
            Stored in sdkconfig, which is not committed to git.

endmenu
```
